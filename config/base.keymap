#include <behaviors.dtsi>
#include <behaviors/num_word.dtsi> // Requires zmk-auto-layer module.
#include <behaviors/unicode.dtsi> // Requires zmk-unicode module.
#include <zmk-helpers/helper.h> // Requires zmk-helpers module.
#include <dt-bindings/zmk/keys.h>
#ifdef CONFIG_WIRELESS
  #include <dt-bindings/zmk/bt.h>
  #include <dt-bindings/zmk/outputs.h>
  #define _BT_SEL_KEYS_                                                        \
      &bt BT_SEL 0 &bt BT_SEL 1 &bt BT_SEL 2 &bt BT_SEL 3 &bt BT_CLR
#else
  #define _BT_SEL_KEYS_ &trans &trans &trans &trans &trans
#endif

#define DEF 0
#define NAV 1
#define FN 2
#define NUM 3
#define SYS 4
#define UTIL 5
#define ADJ 6
#define MOUSE 7
#define SMAC 8
#define NSMAC 9
#define WNAV 10
#define PNAV 11
#define TNAV 12

#define XXX &none
#define ___ &trans

/* Global defaults */

#define QUICK_TAP_MS 175

&sk {
  release-after-ms = <900>;
  quick-release;
};

&sl { // Allow sticky mods to chord across sticky layers.
  ignore-modifiers;
};

&lt {
  flavor = "balanced";
  tapping-term-ms = <200>;
  quick-tap-ms = <QUICK_TAP_MS>;
};

/* Homerow mods */

#define KEYS_L LT0 LT1 LT2 LT3 LT4 LM0 LM1 LM2 LM3 LM4 LB0 LB1 LB2 LB3 LB4
#define KEYS_R RT0 RT1 RT2 RT3 RT4 RM0 RM1 RM2 RM3 RM4 RB0 RB1 RB2 RB3 RB4
#ifndef LH2
  #define THUMBS LH1 LH0 RH0 RH1         // Thumbs on 34 keys.
#else
  #define THUMBS LH2 LH1 LH0 RH0 RH1 RH2 // Thumbs on 36+ keys.
#endif

#define MAKE_HRM(NAME, HOLD, TAP, TRIGGER_POS)                                 \
  ZMK_HOLD_TAP(NAME, bindings = <HOLD>, <TAP>; flavor = "balanced";            \
               tapping-term-ms = <280>; quick-tap-ms = <QUICK_TAP_MS>;         \
               require-prior-idle-ms = <150>; hold-trigger-on-release;         \
               hold-trigger-key-positions = <TRIGGER_POS>;)

MAKE_HRM(hml, &kp, &kp, KEYS_R THUMBS) // Left-hand HRMs.
MAKE_HRM(hmr, &kp, &kp, KEYS_L THUMBS) // Right-hand HRMs.

// Hack: Make HRM combos tap-only (cf, ZMK issue #544).
#define ZMK_COMBO_8(NAME, TAP, POS, LAYERS, COMBO_MS, IDLE_MS, HOLD, SIDE)     \
  MAKE_HRM(hm_combo_##NAME, &kp, TAP, SIDE THUMBS)                             \
  ZMK_COMBO_6(NAME, &hm_combo_##NAME HOLD 0, POS, LAYERS, COMBO_MS, IDLE_MS)

/* Combos, leader key sequences, mouse emulation */

#include "combos.dtsi" // Must be sourced after HRM-combo hack.
#include "leader.dtsi"
#include "mouse.dtsi"

/* Nav cluster */

// Trigger tap-action on all interrupts.
#define MT_CORE                                                                \
  flavor = "tap-preferred";                                                    \
  tapping-term-ms = <220>;                                                     \
  quick-tap-ms = <220>;                                                        \
  hold-trigger-key-positions = <0>;

&mt { MT_CORE };

ZMK_HOLD_TAP(mt_home, bindings = <&masked_home>, <&kp>; MT_CORE)
ZMK_HOLD_TAP(mt_end, bindings = <&masked_end>, <&kp>; MT_CORE)

#define NAV_LEFT  &mt_home 0   LEFT  // Tap: left  | Long-tap: start of line.
#define NAV_RIGHT &mt_end 0    RIGHT // Tap: right | Long-tap: end   of line.
#define NAV_UP    &mt LC(HOME) UP    // Tap: up    | Long-tap: start of doc.
#define NAV_DOWN  &mt LC(END)  DOWN  // Tap: down  | Long-tap: end   of doc.
#define NAV_BSPC  &mt LC(BSPC) BSPC  // Tap: bspc  | Long-tap: delete word bwd.
#define NAV_DEL   &mt LC(DEL)  DEL   // Tap: del   | Long-tap: delete word fwd.

// Mask CTRL on left/right hold to avoid accidental jumps to start/end of doc.
#define MASK_MODS(NAME, MODS, BINDING)                                         \
  ZMK_MOD_MORPH(NAME, bindings = <BINDING>, <BINDING>; mods = <MODS>;)

MASK_MODS(masked_home, (MOD_LCTL), &kp HOME)
MASK_MODS(masked_end,  (MOD_LCTL), &kp END)

/* Magic-shift & auto-layers */

// Tap: repeat after alpha, else sticky-shift |
// Shift + tap/ double-tap: caps-word | Hold: shift.
#define MAGIC_SHIFT &magic_shift LSHFT 0
ZMK_HOLD_TAP(magic_shift, bindings = <&kp>, <&magic_shift_tap>;
             flavor = "balanced"; tapping-term-ms = <200>;
             quick-tap-ms = <QUICK_TAP_MS>;)
ZMK_MOD_MORPH(magic_shift_tap, bindings = <&shift_repeat>, <&caps_word>;
              mods = <(MOD_LSFT)>;)
ZMK_ADAPTIVE_KEY(
    shift_repeat, bindings = <&sk LSHFT>;
    repeat {
      trigger-keys = <A B C D E F G H I J K L M N O P Q R S T U V W X Y Z
                      LPAR RPAR LBKT RBKT LBRC RBRC GT LT>;
      bindings = <&key_repeat>;
      max-prior-idle-ms = <1200>;
      strict-modifiers;
    };)
&caps_word { // Mods deactivate caps-word, requires PR #1451. [TODO: rebase]
    // Allow caps word to continue even when minus or underscore
    // are pressed.
    // Also prevent mod presses from cancelling caps word.
    continue-list = <
      UNDERSCORE MINUS
      LCTRL LALT LGUI LSHFT
      RCTRL RALT RGUI RSHFT
      BACKSPACE
    >;
    /delete-property/ ignore-modifiers;
};

// Tap: num-word | double-tap: sticky num-layer | Hold: num-layer.
#define SMART_NUM &smart_num NUM 0
ZMK_HOLD_TAP(smart_num, bindings = <&mo>, <&num_dance>; flavor = "balanced";
             tapping-term-ms = <200>; quick-tap-ms = <QUICK_TAP_MS>;)
ZMK_TAP_DANCE(num_dance, bindings = <&num_word NUM>, <&sl NUM>;
              tapping-term-ms = <200>;)

// Smart-mouse, requires tri-state module.
ZMK_TRI_STATE(
    smart_mouse, bindings = <&tog MOUSE>, <&none>, <&tog MOUSE>;
    ignored-key-positions =
        <LT1 LT2 LT3 LM0 LM1 LM2 LM3 LM4 RT1 RT2 RT3 RM0 RM1 RM2 RM3 RM4 RB1 RB2 RB3 RH1>;
    ignored-layers = <MOUSE NAV FN>;)

/* Custom behaviors */

//// Alt+Tab swapper, requires tri-state module.
//ZMK_TRI_STATE(swapper, bindings = <&kt LALT>, <&kp TAB>, <&kt LALT>;
//              ignored-key-positions = <LT2 RT2 RM1 RM2 RM3>;)

// Define mod-morph with a *single* mod trigger for less repetition.
#define SIMPLE_MORPH(NAME, MOD, BINDING1, BINDING2)                            \
  ZMK_MOD_MORPH(NAME, mods = <(MOD_L##MOD | MOD_R##MOD)>;                      \
                bindings = <BINDING1>, <BINDING2>;)
#define SIMPLE_ONESIDE_MORPH(NAME, MOD, BINDING1, BINDING2)                    \
  ZMK_MOD_MORPH(NAME, mods = <(MOD_##MOD)>;                                    \
                bindings = <BINDING1>, <BINDING2>;)

// Tap: left/right parenthesis | Shft + tap: less-than/greater-than.
SIMPLE_MORPH(lpar_lt, SFT, &kp LPAR, &kp LT)
SIMPLE_MORPH(rpar_gt, SFT, &kp RPAR, &kp GT)

// Tap: space | Shift + tap: dot -> space -> sticky shift | Hold: nav layer.
ZMK_HOLD_TAP(lt_spc, bindings = <&mo>, <&spc_morph>; flavor = "balanced";
             tapping-term-ms = <400>; quick-tap-ms = <QUICK_TAP_MS>;)
SIMPLE_MORPH(spc_morph, SFT, &kp SPACE, &dot_spc)
ZMK_MACRO(dot_spc, bindings = <&kp DOT &kp SPACE &sk LSHFT>; wait-ms = <0>;
          tap-ms = <5>;)

// Tap: backspace | Lshft + tap: delete | Rshft + tap: shift-delete.
ZMK_MOD_MORPH(bs_del, bindings = <&kp BSPC>, <&kp DEL>;
              mods = <(MOD_LSFT|MOD_RSFT)>; keep-mods = <MOD_RSFT>;)

// Tap: copy | double-tap: cut.
ZMK_TAP_DANCE(copy_cut, bindings = <&kp LC(INS)>, <&kp LC(X)>;
              tapping-term-ms = <200>;)

// Sticky shift + leader.
//ZMK_MACRO(leader_sft, bindings = <&sk LSHFT &leader>;)

#define UNMOD_MACRO(name, release_bindings, tap_bindings) \
    / { \
        macros { \
            name: name { \
                compatible = "zmk,behavior-macro"; \
                wait-ms = <0>; \
                tap-ms = <0>; \
                #binding-cells = <0>; \
                bindings = <&macro_release release_bindings> \
                , <&macro_tap tap_bindings> \
                , <&macro_press release_bindings>; \
            }; \
        }; \
    };
#define UNLSHIFT_MACRO(name, tap_bindings) UNMOD_MACRO(name, &kp LSHIFT, tap_bindings)
#define UNRSHIFT_MACRO(name, tap_bindings) UNMOD_MACRO(name, &kp RSHIFT, tap_bindings)
SIMPLE_ONESIDE_MORPH(unsft_left, LSFT, &unrsft_left, &unlsft_left_inner)
SIMPLE_ONESIDE_MORPH(unrsft_left, RSFT, &kp LEFT, &unrsft_left_inner)
UNRSHIFT_MACRO(unrsft_left_inner, &kp LEFT)
UNLSHIFT_MACRO(unlsft_left_inner, &kp LEFT)

ZMK_MACRO(rpar_left, bindings = <&rpar_gt &unsft_left>; wait-ms = <0>; tap-ms = <0>;)
ZMK_MACRO(lpar_slay, bindings = <&lpar_lt &sl SMAC>; wait-ms = <0>; tap-ms = <0>;)

ZMK_MACRO(gt_left, bindings = <&kp GT &unsft_left>; wait-ms = <0>; tap-ms = <0>;)
ZMK_MACRO(lt_nslay, bindings = <&kp LT &sl NSMAC>; wait-ms = <0>; tap-ms = <0>;)

ZMK_MACRO(rbkt_left, bindings = <&kp RBKT &unsft_left>; wait-ms = <0>; tap-ms = <0>;)
ZMK_MACRO(lbkt_slay, bindings = <&kp LBKT &sl SMAC>; wait-ms = <0>; tap-ms = <0>;)

ZMK_MACRO(rbrc_left, bindings = <&kp RBRC &unsft_left>; wait-ms = <0>; tap-ms = <0>;)
ZMK_MACRO(lbrc_nslay, bindings = <&kp LBRC &sl NSMAC>; wait-ms = <0>; tap-ms = <0>;)

// Tap: comma | Shift + tap: single quote | Ctrl + shift + tap: < |
// Double-tap: cursor inside single quotes.
ZMK_MACRO(sqt_left, bindings = <&kp SQT &kp SQT &unsft_left>; wait-ms = <0>; tap-ms = <0>;)
ZMK_TAP_DANCE(sqt_tap_dance, bindings = <&sqt_always_morph>, <&sqt_left>;
              tapping-term-ms = <200>;)
SIMPLE_MORPH(sqt_always_morph, SFT, &kp SQT, &kp SQT)
SIMPLE_MORPH(comma_morph, SFT, &kp COMMA, &comma_inner_morph)
SIMPLE_MORPH(comma_inner_morph, CTL, &sqt_tap_dance, &kp LESS_THAN)

// Tap: dot | Shift + tap: double quote | Ctrl + shift + tap: > |
// Double-tap: cursor inside double quotes.
ZMK_MACRO(dqt_left, bindings = <&kp DQT &kp DQT &unsft_left>; wait-ms = <0>; tap-ms = <0>;)
ZMK_TAP_DANCE(dqt_tap_dance, bindings = <&dqt_always_morph>, <&dqt_left>;
              tapping-term-ms = <200>;)
SIMPLE_MORPH(dqt_always_morph, SFT, &kp DQT, &kp DQT)
SIMPLE_MORPH(dot_morph, SFT, &kp DOT, &dot_inner_morph)
SIMPLE_MORPH(dot_inner_morph, CTL, &dqt_tap_dance, &kp GREATER_THAN)

// Misc aliases. [TODO: clean up]
#define CANCEL    &kp K_CANCEL            // Cancel caps-word & auto-layers.
#define DSK_PREV  &hmr LCTRL LG(LC(LEFT)) // Previous desktop.
#define DSK_NEXT  &hmr LALT LG(LC(RIGHT)) // Next     desktop.
#define PIN_WIN   &kp LG(LC(LS(Q)))       // Pin window across desktops.
#define PIN_APP   &kp LG(LC(LS(A)))       // Pin application across desktops.
#define DSK_MGR   &kp LA(GRAVE)           // Desktop manager.
#define VOL_DOWN  &hmr RSHFT C_VOL_DN

/* Keymap */

ZMK_CONDITIONAL_LAYER(sys, UTIL NUM, SYS) // UTIL + NUM --> SYS.
SIMPLE_MORPH(fn_adj_morph, ALT, &mo FN, &mo ADJ)

ZMK_LAYER(base,
/*╭─────────────┬─────────────┬─────────────┬─────────────┬─────────────┬─────────────╮                             ╭─────────────┬─────────────┬─────────────┬─────────────┬─────────────┬─────────────╮*/
    &kp GRAVE     &kp N1        &kp N2        &kp N3        &kp N4        &kp N5                                      &kp N6        &kp N7        &kp N8        &kp N9        &kp N0        ___
/*├─────────────┼─────────────┼─────────────┼─────────────┼─────────────┼─────────────┤                             ├─────────────┼─────────────┼─────────────┼─────────────┼─────────────┼─────────────┤*/
    &kp ESC       &kp Q         &kp W         &kp E         &kp R         &kp T                                       &kp Y         &kp U         &kp I         &kp O         &kp P         &kp BSPC
/*├─────────────┼─────────────┼─────────────┼─────────────┼─────────────┼─────────────┤                             ├─────────────┼─────────────┼─────────────┼─────────────┼─────────────┼─────────────┤*/
    &kp TAB       &hml LGUI A   &hml LALT S   &hml LSHFT D  &hml LCTRL F  &kp G                                       &kp H         &hmr LCTRL J  &hmr RSHFT K  &hmr LALT L  &hmr LGUI SEMI &kp SQT
/*├─────────────┼─────────────┼─────────────┼─────────────┼─────────────┼─────────────┼─────────────╮ ╭─────────────┼─────────────┼─────────────┼─────────────┼─────────────┼─────────────┼─────────────┤*/
    ___           &kp Z         &kp X         &kp C         &kp V         &kp B         &kp C_MUTE      ___           &kp N         &kp M         &comma_morph  &dot_morph    &kp FSLH      ___
/*╰─────────────┴─────────────┼─────────────┼─────────────┼─────────────┼─────────────┼─────────────┤ ├─────────────┼─────────────┼─────────────┼─────────────┴─────────────┴───────────────────────────╯*/
                                ___           ___          &fn_adj_morph  &lt_spc NAV 0 &lt UTIL RET    SMART_NUM     MAGIC_SHIFT   &kp RALT      ___           ___
/*                            ╰─────────────┴─────────────┴─────────────┴─────────────┴─────────────╯ ╰─────────────┴─────────────┴─────────────┴─────────────┴─────────────╯*/
,
   &inc_dec_kp C_VOL_UP C_VOL_DN &inc_dec_kp PG_UP PG_DN
)

ZMK_LAYER(nav,
/*╭─────────────┬─────────────┬─────────────┬─────────────┬─────────────┬─────────────╮                             ╭─────────────┬─────────────┬─────────────┬─────────────┬─────────────┬─────────────╮*/
    ___           ___           ___           ___           ___           ___                                         ___           ___           ___           ___           ___           ___
/*├─────────────┼─────────────┼─────────────┼─────────────┼─────────────┼─────────────┤                             ├─────────────┼─────────────┼─────────────┼─────────────┼─────────────┼─────────────┤*/
    ___           ___           U_WH_D        U_MS_U        U_WH_U        ___                                         ___           ___           ___           ___           ___           ___
/*├─────────────┼─────────────┼─────────────┼─────────────┼─────────────┼─────────────┤                             ├─────────────┼─────────────┼─────────────┼─────────────┼─────────────┼─────────────┤*/
    ___           U_WH_L        U_MS_L        U_MS_D        U_MS_R        U_WH_R                                      &kp LEFT      &kp DOWN      &kp UP        &kp RIGHT     &kp DEL       &kp BSPC
/*├─────────────┼─────────────┼─────────────┼─────────────┼─────────────┼─────────────┼─────────────╮ ╭─────────────┼─────────────┼─────────────┼─────────────┼─────────────┼─────────────┼─────────────┤*/
    ___           ___           ___           ___           ___           ___           ___             ___           ___           &mkp LCLK     &mkp MCLK     &mkp RCLK     ___           ___
/*╰─────────────┴─────────────┼─────────────┼─────────────┼─────────────┼─────────────┼─────────────┤ ├─────────────┼─────────────┼─────────────┼─────────────┴─────────────┴───────────────────────────╯*/
                                ___           ___           ___           ___           ___             &mo WNAV      CANCEL        &mo PNAV      ___           ___
/*                            ╰─────────────┴─────────────┴─────────────┴─────────────┴─────────────╯ ╰─────────────┴─────────────┴─────────────┴─────────────┴─────────────╯*/
,
   &inc_dec_kp C_VOL_UP C_VOL_DN &inc_dec_kp PG_UP PG_DN
)

ZMK_LAYER(fn,
/*╭─────────────┬─────────────┬─────────────┬─────────────┬─────────────┬─────────────╮                             ╭─────────────┬─────────────┬─────────────┬─────────────┬─────────────┬─────────────╮*/
    ___           ___           ___           ___           ___           ___                                         ___           ___           ___           ___           ___           ___
/*├─────────────┼─────────────┼─────────────┼─────────────┼─────────────┼─────────────┤                             ├─────────────┼─────────────┼─────────────┼─────────────┼─────────────┼─────────────┤*/
    ___           &kp F12       &kp F7        &kp F8        &kp F9        ___                                         ___           &kp C_PREV    &kp C_VOL_UP  &kp C_NEXT    ___           ___
/*├─────────────┼─────────────┼─────────────┼─────────────┼─────────────┼─────────────┤                             ├─────────────┼─────────────┼─────────────┼─────────────┼─────────────┼─────────────┤*/
    ___          &hml LGUI F11  &hml LALT F4 &hml LSHFT F5 &hml LCTRL F6  ___                                         ___           ___           VOL_DOWN      ___           ___           ___
/*├─────────────┼─────────────┼─────────────┼─────────────┼─────────────┼─────────────┼─────────────╮ ╭─────────────┼─────────────┼─────────────┼─────────────┼─────────────┼─────────────┼─────────────┤*/
    ___           &kp F10       &kp F1        &kp F2        &kp F3        ___           ___             ___           ___           ___           ___           ___           ___           ___
/*╰─────────────┴─────────────┼─────────────┼─────────────┼─────────────┼─────────────┼─────────────┤ ├─────────────┼─────────────┼─────────────┼─────────────┴─────────────┴───────────────────────────╯*/
                                ___           ___           ___           ___           ___             ___           &kp C_MUTE    &kp C_PP      ___           ___
/*                            ╰─────────────┴─────────────┴─────────────┴─────────────┴─────────────╯ ╰─────────────┴─────────────┴─────────────┴─────────────┴─────────────╯*/
,
   &inc_dec_kp C_VOL_UP C_VOL_DN &inc_dec_kp PG_UP PG_DN
)

ZMK_LAYER(num,
/*╭─────────────┬─────────────┬─────────────┬─────────────┬─────────────┬─────────────╮                             ╭─────────────┬─────────────┬─────────────┬─────────────┬─────────────┬─────────────╮*/
    ___           ___           ___           ___           ___           ___                                         ___           ___           ___           ___           ___           ___
/*├─────────────┼─────────────┼─────────────┼─────────────┼─────────────┼─────────────┤                             ├─────────────┼─────────────┼─────────────┼─────────────┼─────────────┼─────────────┤*/
    ___           ___           &kp N7        &kp N8        &kp N9        ___                                         ___           ___           ___           ___           ___           ___
/*├─────────────┼─────────────┼─────────────┼─────────────┼─────────────┼─────────────┤                             ├─────────────┼─────────────┼─────────────┼─────────────┼─────────────┼─────────────┤*/
    ___           &hml LGUI N0  &hml LALT N4  &hml LSHFT N5 &hml LCTRL N6 ___                                         ___           ___           ___           ___           ___           ___
/*├─────────────┼─────────────┼─────────────┼─────────────┼─────────────┼─────────────┼─────────────╮ ╭─────────────┼─────────────┼─────────────┼─────────────┼─────────────┼─────────────┼─────────────┤*/
    ___           ___           &kp N1        &kp N2        &kp N3        ___           ___             ___           ___           ___           ___           ___           ___           ___
/*╰─────────────┴─────────────┼─────────────┼─────────────┼─────────────┼─────────────┼─────────────┤ ├─────────────┼─────────────┼─────────────┼─────────────┴─────────────┴───────────────────────────╯*/
                                ___           ___           ___           ___           ___             ___           ___           ___           ___           ___
/*                            ╰─────────────┴─────────────┴─────────────┴─────────────┴─────────────╯ ╰─────────────┴─────────────┴─────────────┴─────────────┴─────────────╯*/
,
   &inc_dec_kp C_VOL_UP C_VOL_DN &inc_dec_kp PG_UP PG_DN
)


ZMK_LAYER(sys,
/*╭─────────────┬─────────────┬─────────────┬─────────────┬─────────────┬─────────────╮                             ╭─────────────┬─────────────┬─────────────┬─────────────┬─────────────┬─────────────╮*/
    ___           ___           ___           ___           ___           ___                                         ___           ___           ___           ___           ___           ___
/*├─────────────┼─────────────┼─────────────┼─────────────┼─────────────┼─────────────┤                             ├─────────────┼─────────────┼─────────────┼─────────────┼─────────────┼─────────────┤*/
    ___                           _BT_SEL_KEYS_                                                                       ___           ___           ___           ___           ___           ___
/*├─────────────┼─────────────┼─────────────┼─────────────┼─────────────┼─────────────┤                             ├─────────────┼─────────────┼─────────────┼─────────────┼─────────────┼─────────────┤*/
    ___           ___           ___           ___       &ext_power EP_TOG &bootloader                                 &bootloader   ___           ___           ___           ___           ___
/*├─────────────┼─────────────┼─────────────┼─────────────┼─────────────┼─────────────┼─────────────╮ ╭─────────────┼─────────────┼─────────────┼─────────────┼─────────────┼─────────────┼─────────────┤*/
    ___           ___           ___           ___         &rgb_ug RGB_TOG &sys_reset    ___             ___           &sys_reset    ___           ___           ___           ___           ___
/*╰─────────────┴─────────────┼─────────────┼─────────────┼─────────────┼─────────────┼─────────────┤ ├─────────────┼─────────────┼─────────────┼─────────────┴─────────────┴───────────────────────────╯*/
                                ___           ___           ___           ___           ___             ___           ___           ___           ___           ___
/*                            ╰─────────────┴─────────────┴─────────────┴─────────────┴─────────────╯ ╰─────────────┴─────────────┴─────────────┴─────────────┴─────────────╯*/
)

ZMK_LAYER(util,
/*╭─────────────┬─────────────┬─────────────┬─────────────┬─────────────┬─────────────╮                             ╭─────────────┬─────────────┬─────────────┬─────────────┬─────────────┬─────────────╮*/
    ___           ___           ___           ___           ___           ___                                         ___           ___           ___           ___           ___           ___
/*├─────────────┼─────────────┼─────────────┼─────────────┼─────────────┼─────────────┤                             ├─────────────┼─────────────┼─────────────┼─────────────┼─────────────┼─────────────┤*/
    ___           ___           ___           ___           ___           ___                                         ___           ___           ___           ___           ___           ___
/*├─────────────┼─────────────┼─────────────┼─────────────┼─────────────┼─────────────┤                             ├─────────────┼─────────────┼─────────────┼─────────────┼─────────────┼─────────────┤*/
    ___           ___           ___           ___           ___           ___                                         ___           ___           ___           ___           ___           ___
/*├─────────────┼─────────────┼─────────────┼─────────────┼─────────────┼─────────────┼─────────────╮ ╭─────────────┼─────────────┼─────────────┼─────────────┼─────────────┼─────────────┼─────────────┤*/
    ___           ___           ___           ___           ___           ___           ___             ___           ___           ___           ___           ___           ___           ___
/*╰─────────────┴─────────────┼─────────────┼─────────────┼─────────────┼─────────────┼─────────────┤ ├─────────────┼─────────────┼─────────────┼─────────────┴─────────────┴───────────────────────────╯*/
                                ___           ___           ___           ___           ___             ___           ___           ___           ___           ___
/*                            ╰─────────────┴─────────────┴─────────────┴─────────────┴─────────────╯ ╰─────────────┴─────────────┴─────────────┴─────────────┴─────────────╯*/
)

#define UG_RGB_ON  &rgb_ug RGB_ON  // Turns the RGB feature on
#define UG_RGB_OFF &rgb_ug RGB_OFF // Turns the RGB feature off
#define UG_RGB_TOG &rgb_ug RGB_TOG // Toggles the RGB feature on and off
#define UG_RGB_HUI &rgb_ug RGB_HUI // Increases the hue of the RGB feature
#define UG_RGB_HUD &rgb_ug RGB_HUD // Decreases the hue of the RGB feature
#define UG_RGB_SAI &rgb_ug RGB_SAI // Increases the saturation of the RGB feature
#define UG_RGB_SAD &rgb_ug RGB_SAD // Decreases the saturation of the RGB feature
#define UG_RGB_BRI &rgb_ug RGB_BRI // Increases the brightness of the RGB feature
#define UG_RGB_BRD &rgb_ug RGB_BRD // Decreases the brightness of the RGB feature
#define UG_RGB_SPI &rgb_ug RGB_SPI // Increases the speed of the RGB feature effect's animation
#define UG_RGB_SPD &rgb_ug RGB_SPD // Decreases the speed of the RGB feature effect's animation
#define UG_RGB_EFF &rgb_ug RGB_EFF // Cycles the RGB feature's effect forwards
#define UG_RGB_EFR &rgb_ug RGB_EFR // Cycles the RGB feature's effect reverse

ZMK_LAYER(adj,
/*╭─────────────┬─────────────┬─────────────┬─────────────┬─────────────┬─────────────╮                             ╭─────────────┬─────────────┬─────────────┬─────────────┬─────────────┬─────────────╮*/
    ___           ___           ___           ___           ___           ___                                         ___           ___           ___           ___           ___           ___
/*├─────────────┼─────────────┼─────────────┼─────────────┼─────────────┼─────────────┤                             ├─────────────┼─────────────┼─────────────┼─────────────┼─────────────┼─────────────┤*/
    ___           ___           ___           ___           ___           ___                                         UG_RGB_HUI    UG_RGB_SAI    UG_RGB_BRI    UG_RGB_SPI    UG_RGB_EFF    ___
/*├─────────────┼─────────────┼─────────────┼─────────────┼─────────────┼─────────────┤                             ├─────────────┼─────────────┼─────────────┼─────────────┼─────────────┼─────────────┤*/
    ___           ___           ___           ___           ___           ___                                         UG_RGB_HUD    UG_RGB_SAD    UG_RGB_BRD    UG_RGB_SPD    UG_RGB_EFR    ___
/*├─────────────┼─────────────┼─────────────┼─────────────┼─────────────┼─────────────┼─────────────╮ ╭─────────────┼─────────────┼─────────────┼─────────────┼─────────────┼─────────────┼─────────────┤*/
    ___           ___           ___           ___           ___           ___           ___             ___           ___           ___           ___           ___           ___           ___
/*╰─────────────┴─────────────┼─────────────┼─────────────┼─────────────┼─────────────┼─────────────┤ ├─────────────┼─────────────┼─────────────┼─────────────┴─────────────┴───────────────────────────╯*/
                                ___           ___           ___           ___           ___             ___           ___           ___           ___          ___
/*                            ╰─────────────┴─────────────┴─────────────┴─────────────┴─────────────╯ ╰─────────────┴─────────────┴─────────────┴─────────────┴─────────────╯*/
)

/*
  ╭─────────────────────╮ ╭─────────────────────╮
  │ LT4 LT3 LT2 LT1 LT0 │ │ RT0 RT1 RT2 RT3 RT4 │
  │ LM4 LM3 LM2 LM1 LM0 │ │ RM0 RM1 RM2 RM3 RM4 │
  │ LB4 LB3 LB2 LB1 LB0 │ │ RB0 RB1 RB2 RB3 RB4 │
  ╰───────╮ LH2 LH1 LH0 │ │ RH0 RH1 RH2 ╭───────╯
          ╰─────────────╯ ╰─────────────╯ */
ZMK_LAYER(mouse,
/*╭─────────────┬─────────────┬─────────────┬─────────────┬─────────────┬─────────────╮                             ╭─────────────┬─────────────┬─────────────┬─────────────┬─────────────┬─────────────╮*/
    ___           ___           ___           ___           ___           ___                                         ___           ___           ___           ___           ___           ___
/*├─────────────┼─────────────┼─────────────┼─────────────┼─────────────┼─────────────┤                             ├─────────────┼─────────────┼─────────────┼─────────────┼─────────────┼─────────────┤*/
    ___           ___           U_WH_D        U_MS_U        U_WH_U        ___                                         ___           U_WH_D        U_MS_U        U_WH_U        ___           ___
/*├─────────────┼─────────────┼─────────────┼─────────────┼─────────────┼─────────────┤                             ├─────────────┼─────────────┼─────────────┼─────────────┼─────────────┼─────────────┤*/
    ___           U_WH_L        U_MS_L        U_MS_D        U_MS_R        U_WH_R                                      U_WH_L        U_MS_L        U_MS_D        U_MS_R        U_WH_R        ___
/*├─────────────┼─────────────┼─────────────┼─────────────┼─────────────┼─────────────┼─────────────╮ ╭─────────────┼─────────────┼─────────────┼─────────────┼─────────────┼─────────────┼─────────────┤*/
    ___           ___           ___           ___           ___           ___           ___             ___           ___           &mkp LCLK     &mkp MCLK     &mkp RCLK     ___           ___
/*╰─────────────┴─────────────┼─────────────┼─────────────┼─────────────┼─────────────┼─────────────┤ ├─────────────┼─────────────┼─────────────┼─────────────┴─────────────┴───────────────────────────╯*/
                                ___           ___           ___           ___           ___             ___           CANCEL        ___           ___           ___
/*                            ╰─────────────┴─────────────┴─────────────┴─────────────┴─────────────╯ ╰─────────────┴─────────────┴─────────────┴─────────────┴─────────────╯*/
)

ZMK_LAYER(sticky_macros,
/*╭─────────────┬─────────────┬─────────────┬─────────────┬─────────────┬─────────────╮                             ╭─────────────┬─────────────┬─────────────┬─────────────┬─────────────┬─────────────╮*/
    ___           ___           ___           ___           ___           ___                                         ___           ___           ___           ___           ___           ___
/*├─────────────┼─────────────┼─────────────┼─────────────┼─────────────┼─────────────┤                             ├─────────────┼─────────────┼─────────────┼─────────────┼─────────────┼─────────────┤*/
    ___           ___           ___           ___           ___           ___                                         ___           ___           ___           ___           ___           ___
/*├─────────────┼─────────────┼─────────────┼─────────────┼─────────────┼─────────────┤                             ├─────────────┼─────────────┼─────────────┼─────────────┼─────────────┼─────────────┤*/
    ___           ___           ___           ___           ___           ___                                         ___           ___           ___           ___           ___           ___
/*├─────────────┼─────────────┼─────────────┼─────────────┼─────────────┼─────────────┼─────────────╮ ╭─────────────┼─────────────┼─────────────┼─────────────┼─────────────┼─────────────┼─────────────┤*/
    ___           ___           ___           ___           ___           ___           ___             ___           ___           ___           ___           ___           ___           ___
/*╰─────────────┴─────────────┼─────────────┼─────────────┼─────────────┼─────────────┼─────────────┤ ├─────────────┼─────────────┼─────────────┼─────────────┴─────────────┴───────────────────────────╯*/
                                &tog SMAC     ___           ___           ___           ___             ___           MAGIC_SHIFT   ___           ___           ___
/*                            ╰─────────────┴─────────────┴─────────────┴─────────────┴─────────────╯ ╰─────────────┴─────────────┴─────────────┴─────────────┴─────────────╯*/
)

ZMK_LAYER(nav_sticky_macros,
/*╭─────────────┬─────────────┬─────────────┬─────────────┬─────────────┬─────────────╮                             ╭─────────────┬─────────────┬─────────────┬─────────────┬─────────────┬─────────────╮*/
    ___           ___           ___           ___           ___           ___                                         ___           ___           ___           ___           ___           ___
/*├─────────────┼─────────────┼─────────────┼─────────────┼─────────────┼─────────────┤                             ├─────────────┼─────────────┼─────────────┼─────────────┼─────────────┼─────────────┤*/
    ___           ___           ___           ___           ___           ___                                         ___           ___           ___           ___           ___           ___
/*├─────────────┼─────────────┼─────────────┼─────────────┼─────────────┼─────────────┤                             ├─────────────┼─────────────┼─────────────┼─────────────┼─────────────┼─────────────┤*/
    ___           ___           ___           ___           ___           ___                                         ___           ___           ___           ___           ___           ___
/*├─────────────┼─────────────┼─────────────┼─────────────┼─────────────┼─────────────┼─────────────╮ ╭─────────────┼─────────────┼─────────────┼─────────────┼─────────────┼─────────────┼─────────────┤*/
    ___           ___           ___           ___           ___           ___           ___             ___           ___           ___           ___           ___           ___           ___
/*╰─────────────┴─────────────┼─────────────┼─────────────┼─────────────┼─────────────┼─────────────┤ ├─────────────┼─────────────┼─────────────┼─────────────┴─────────────┴───────────────────────────╯*/
                                &tog NSMAC    ___           ___           ___           ___             ___           MAGIC_SHIFT   ___           ___           ___
/*                            ╰─────────────┴─────────────┴─────────────┴─────────────┴─────────────╯ ╰─────────────┴─────────────┴─────────────┴─────────────┴─────────────╯*/
)

ZMK_LAYER(nav_warp,
/*╭─────────────┬─────────────┬─────────────┬─────────────┬─────────────┬─────────────╮                             ╭─────────────┬─────────────┬─────────────┬─────────────┬─────────────┬─────────────╮*/
    ___           ___           ___           ___           ___           ___                                         ___           ___           ___           ___           ___           ___
/*├─────────────┼─────────────┼─────────────┼─────────────┼─────────────┼─────────────┤                             ├─────────────┼─────────────┼─────────────┼─────────────┼─────────────┼─────────────┤*/
    ___           ___           ___           ___           ___           ___                                         ___           ___           ___           ___           ___           ___
/*├─────────────┼─────────────┼─────────────┼─────────────┼─────────────┼─────────────┤                             ├─────────────┼─────────────┼─────────────┼─────────────┼─────────────┼─────────────┤*/
    ___           ___           ___           ___           ___           ___                                         ___           ___           ___           ___           &mo TNAV      ___
/*├─────────────┼─────────────┼─────────────┼─────────────┼─────────────┼─────────────┼─────────────╮ ╭─────────────┼─────────────┼─────────────┼─────────────┼─────────────┼─────────────┼─────────────┤*/
    ___           ___           ___           ___           ___           ___           ___             ___           ___           ___           ___           ___           ___           ___
/*╰─────────────┴─────────────┼─────────────┼─────────────┼─────────────┼─────────────┼─────────────┤ ├─────────────┼─────────────┼─────────────┼─────────────┴─────────────┴───────────────────────────╯*/
                                &tog WNAV     ___           ___           ___           ___             ___           MAGIC_SHIFT   ___           ___           ___
/*                            ╰─────────────┴─────────────┴─────────────┴─────────────┴─────────────╯ ╰─────────────┴─────────────┴─────────────┴─────────────┴─────────────╯*/
)

ZMK_LAYER(nav_precision,
/*╭─────────────┬─────────────┬─────────────┬─────────────┬─────────────┬─────────────╮                             ╭─────────────┬─────────────┬─────────────┬─────────────┬─────────────┬─────────────╮*/
    ___           ___           ___           ___           ___           ___                                         ___           ___           ___           ___           ___           ___
/*├─────────────┼─────────────┼─────────────┼─────────────┼─────────────┼─────────────┤                             ├─────────────┼─────────────┼─────────────┼─────────────┼─────────────┼─────────────┤*/
    ___           ___           ___           ___           ___           ___                                         ___           ___           ___           ___           ___           ___
/*├─────────────┼─────────────┼─────────────┼─────────────┼─────────────┼─────────────┤                             ├─────────────┼─────────────┼─────────────┼─────────────┼─────────────┼─────────────┤*/
    ___           ___           ___           ___           ___           ___                                         ___           ___           ___           ___           ___           ___
/*├─────────────┼─────────────┼─────────────┼─────────────┼─────────────┼─────────────┼─────────────╮ ╭─────────────┼─────────────┼─────────────┼─────────────┼─────────────┼─────────────┼─────────────┤*/
    ___           ___           ___           ___           ___           ___           ___             ___           ___           ___           ___           ___           ___           ___
/*╰─────────────┴─────────────┼─────────────┼─────────────┼─────────────┼─────────────┼─────────────┤ ├─────────────┼─────────────┼─────────────┼─────────────┴─────────────┴───────────────────────────╯*/
                                &tog PNAV     ___           ___           ___           ___             ___           MAGIC_SHIFT   ___           ___           ___
/*                            ╰─────────────┴─────────────┴─────────────┴─────────────┴─────────────╯ ╰─────────────┴─────────────┴─────────────┴─────────────┴─────────────╯*/
)

ZMK_LAYER(nav_teleport,
/*╭─────────────┬─────────────┬─────────────┬─────────────┬─────────────┬─────────────╮                             ╭─────────────┬─────────────┬─────────────┬─────────────┬─────────────┬─────────────╮*/
    ___           ___           ___           ___           ___           ___                                         ___           ___           ___           ___           ___           ___
/*├─────────────┼─────────────┼─────────────┼─────────────┼─────────────┼─────────────┤                             ├─────────────┼─────────────┼─────────────┼─────────────┼─────────────┼─────────────┤*/
    ___           ___           ___           ___           ___           ___                                         ___           ___           ___           ___           ___           ___
/*├─────────────┼─────────────┼─────────────┼─────────────┼─────────────┼─────────────┤                             ├─────────────┼─────────────┼─────────────┼─────────────┼─────────────┼─────────────┤*/
    ___           ___           ___           ___           ___           ___                                         ___           ___           ___           ___           ___           ___
/*├─────────────┼─────────────┼─────────────┼─────────────┼─────────────┼─────────────┼─────────────╮ ╭─────────────┼─────────────┼─────────────┼─────────────┼─────────────┼─────────────┼─────────────┤*/
    ___           ___           ___           ___           ___           ___           ___             ___           ___           ___           ___           ___           ___           ___
/*╰─────────────┴─────────────┼─────────────┼─────────────┼─────────────┼─────────────┼─────────────┤ ├─────────────┼─────────────┼─────────────┼─────────────┴─────────────┴───────────────────────────╯*/
                                &tog TNAV     ___           ___           ___           ___             ___           MAGIC_SHIFT   ___           ___           ___
/*                            ╰─────────────┴─────────────┴─────────────┴─────────────┴─────────────╯ ╰─────────────┴─────────────┴─────────────┴─────────────┴─────────────╯*/
)
